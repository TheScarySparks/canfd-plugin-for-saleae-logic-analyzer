VERSION ""

NS_ :

BS_:

BU_: ECU

BO_ 256 MsgIntel: 8 ECU
 SG_ SigIntel : 0|16@1+ (0.1,0) [0|0] "degC" ECU

BO_ 257 MsgMotoFullByte: 8 ECU
 SG_ SigMotoFullByte : 23|8@0+ (1,0) [0|0] "" ECU

BO_ 258 MsgMotoCross: 8 ECU
 SG_ SigMotoCross : 36|12@0+ (1,0) [0|0] "" ECU

BO_ 259 MsgSigned: 8 ECU
 SG_ SigSigned : 0|8@1- (1,-10) [0|0] "" ECU

BO_ 512 MsgMux: 8 ECU
 SG_ SigMuxSel M : 0|2@1+ (1,0) [0|0] "" ECU
 SG_ SigA m0 : 8|8@1+ (1,0) [0|0] "" ECU
 SG_ SigB m1 : 8|8@1+ (2,0) [0|0] "" ECU

BO_ 2147483939 MsgExt: 4 ECU
 SG_ SigExt : 0|16@1+ (1,0) [0|0] "" ECU

BO_ 1886 MsgSmokeTest: 8 ECU
 SG_ SigSmokeTest : 0|8@1+ (1,0) [0|0] "" ECU
